## CMakeLists.txt
```
# SPDX-License-Identifier: Apache-2.0

cmake_minimum_required(VERSION 3.20.0)
find_package(Zephyr REQUIRED HINTS $ENV{ZEPHYR_BASE})
project(blinky)

include_directories(include)

target_sources(app PRIVATE src/main.c src/led_driver.c src/temperature_driver.c)
```

## prj.conf
```kconfig
CONFIG_GPIO=y
CONFIG_LOG=y
CONFIG_ASSERT=y
CONFIG_ASSERT_ON_ERRORS=y
# CONFIG_NO_RUNTIME_CHECKS=y
CONFIG_REQUIRES_FLOAT_PRINTF=y
CONFIG_FPU=y
CONFIG_ZBUS=y
```

## src/main.c
```c
/*
 * Copyright (c) 2024 IC UFAL
 *
 * SPDX-License-Identifier: Apache-2.0
 */

#include <zephyr/kernel.h>

#include "led_driver.h"
#include "temperature_driver.h"

#include <zephyr/logging/log.h>
LOG_MODULE_REGISTER(main, 4);

int main(void)
{
	// temperature_driver_open(NULL);

	struct temperature_driver temp1;
	temperature_driver_open(&temp1);
	temp1.i = 33;
	temp1.q = 57;

	struct temperature_driver temp2;
	temperature_driver_open(&temp2);
	temp2.i = 23;
	temp2.q = 19;

	led_driver_open();
	led_driver_ioctl(10);

	while (1) {

		led_driver_write(BLINK);
		double t1;
		temperature_driver_read(&temp1, &t1);

		double t2;
		temperature_driver_read(&temp2, &t2);

		LOG_DBG("Temperature t1 = %.02f, t2 = %.02f", t1, t2);

		k_msleep(1000);
	}
	return 0;
}
```

## include/led_driver.h
```c
#include <stdbool.h>
#include <zephyr/kernel.h>

enum led_driver_action {
	OFF,
	ON,
	TOGGLE,
	BLINK,
};

int led_driver_open();

int led_driver_write(enum led_driver_action action);

/**
 * @brief function to retrieve the led state
 *
 * @param[out] is_on
 * @retval 0 success
 * @retval -EINVAL invalid reference
 */
int led_driver_read(bool *is_on);

int led_driver_ioctl(int duration);
```

## include/temperature_driver.h
```c
#include <stdbool.h>
#include <zephyr/kernel.h>

struct temperature_driver {
	uint8_t i;
	uint8_t q;
	bool is_celsius;
};

int temperature_driver_open(struct temperature_driver *self);

int temperature_driver_write(struct temperature_driver *self);

int temperature_driver_read(struct temperature_driver *self, double *temperature);

int temperature_driver_ioctl(struct temperature_driver *self, bool is_celsius);
```

## src/led_driver.c
```c
/*
 * Copyright (c) 2016 Intel Corporation
 *
 * SPDX-License-Identifier: Apache-2.0
 */
#include <stdio.h>
#include <zephyr/drivers/gpio.h>

#include "led_driver.h"

#include <zephyr/logging/log.h>
LOG_MODULE_REGISTER(led_driver, 4);

/* The devicetree node identifier for the "led0" alias. */
#define LED0_NODE DT_ALIAS(led0)

static struct {
	bool is_on;
	const struct gpio_dt_spec led;
	int blink_duration;
} self = {
	.is_on = false,
	.led = GPIO_DT_SPEC_GET(LED0_NODE, gpios),
	.blink_duration = 1000,
};

int led_driver_open()
{
	if (!gpio_is_ready_dt(&self.led)) {
		return -ENODEV;
	}

	int ret = gpio_pin_configure_dt(&self.led, GPIO_OUTPUT_ACTIVE);

	if (ret < 0) {
		return ret;
	}

	return 0;
}

static inline void update_led_state()
{
	gpio_pin_set_dt(&self.led, self.is_on);
	LOG_DBG("LED state: %s", self.is_on ? "ON" : "OFF");
}

int led_driver_write(enum led_driver_action action)
{
	int ret = 0;
	switch (action) {
	case OFF:
		self.is_on = false;
		update_led_state();
		break;
	case ON:
		self.is_on = true;
		update_led_state();
		break;
	case TOGGLE:
		self.is_on = !self.is_on;
		update_led_state();
		break;
	case BLINK:
		self.is_on = !self.is_on;
		update_led_state();
		k_msleep(self.blink_duration);
		self.is_on = !self.is_on;
		update_led_state();
		break;
	}

	return ret;
}

int led_driver_read(bool *is_on)
{
	if (is_on == NULL) {
		return -EINVAL;
	}

	*is_on = self.is_on;

	return 0;
}

int led_driver_ioctl(int duration)
{
	self.blink_duration = duration;

	return 0;
}
```

## src/temperature_driver.c
```c
#include "temperature_driver.h"

#include <zephyr/sys/check.h>

int temperature_driver_open(struct temperature_driver *self)
{
	CHECKIF(self == NULL) {
		return -EINVAL;
	}

	self->i = 0;
	self->q = 0;

	return 0;
}

int temperature_driver_write(struct temperature_driver *self)
{
	__ASSERT_UNREACHABLE;
	return -ENOTSUP;
}

int temperature_driver_read(struct temperature_driver *self, double *temperature)
{
	CHECKIF(self == NULL) {
		return -EINVAL;
	}

	*temperature = self->i + self->q / 100.0;

	return 0;
}

int temperature_driver_ioctl(struct temperature_driver *self, bool is_celsius)
{
	CHECKIF(self == NULL) {
		return -EINVAL;
	}

	self->is_celsius = is_celsius;

	return 0;
}
```
