## prj.conf
```kconfig
# nothing here
CONFIG_BOOT_BANNER=n
CONFIG_MY_LOG=n
CONFIG_SHELL=y
CONFIG_QEMU_ICOUNT=n
CONFIG_NO_OPTIMIZATIONS=n
CONFIG_ASSERT=y
```

## src/main.c
```c
#include <zephyr/kernel.h>

enum event {
	TIMEOUT,
	EVENT_COUNT,
};

enum state {
	RED,
	GREEN,
	YELLOW,
	STATE_COUNT,
};

struct next_state_info {
	enum state next_state;
	k_timeout_t timeout;
};

struct next_state_info state_machine[STATE_COUNT] = {
	[RED] = {.next_state = GREEN, .timeout = K_SECONDS(5)},
	[GREEN] = {.next_state = YELLOW, .timeout = K_SECONDS(1)},
	[YELLOW] = {.next_state = RED, .timeout = K_SECONDS(3)},
};

int state_action(enum state current_state)
{
	switch (current_state) {
	case RED:
		printk("RED\n");
		return 0;
	case GREEN:
		printk("GREEN\n");
		return 0;
	case YELLOW:
		printk("YELLOW\n");
		return 0;
	case STATE_COUNT:
		return -1;
	}
}

enum state current_state = YELLOW;

void timer_state_expiry_fn(struct k_timer *t);
K_TIMER_DEFINE(timer_state, timer_state_expiry_fn, NULL);

void timer_state_expiry_fn(struct k_timer *t)
{
	struct next_state_info new_state_info = state_machine[current_state];

	if (new_state_info.next_state != current_state) {
		state_action(new_state_info.next_state);
		current_state = new_state_info.next_state;
		k_timer_start(&timer_state, new_state_info.timeout, K_NO_WAIT);
	}
}
int main(int argc, char *argv[])
{
	state_action(current_state);
	k_timer_start(&timer_state, state_machine[current_state].timeout, K_NO_WAIT);
	return 0;
}
```

## src/main_event_centric.c
```c
#include <zephyr/kernel.h>

enum event {
	GO,
	STOP,
	TIMEOUT,
	END_OF_EVENTS,
};

enum state {
	RED,
	GREEN,
	YELLOW,
	INVALID,
};

enum state state_machine(enum event evt)
{
	static enum state state = YELLOW;

	switch (evt) {
	case GO:
		if (state == RED) {
			state = GREEN;
		}
		break;
	case STOP:
		if (state == GREEN) {
			state = YELLOW;
		}
		break;
	case TIMEOUT:
		if (state == YELLOW) {
			state = RED;
		}
		break;
	default:
		k_oops();
	}
	return state;
}

int main(int argc, char *argv[])
{
	enum state current_state = INVALID;
	enum event evts[] = {GO, STOP, GO, TIMEOUT, STOP, GO, STOP, END_OF_EVENTS};
	for (int i = 0; evts[i] != END_OF_EVENTS; ++i) {
		current_state = state_machine(evts[i]);
	}
	__ASSERT(current_state == YELLOW, "Must be yellow");
	return 0;
}
```

## src/main_state_centric.c
```c
#include <zephyr/kernel.h>

enum event {
	GO,
	STOP,
	TIMEOUT,
	EVENT_COUNT,
};

enum state {
	RED,
	GREEN,
	YELLOW,
	STATE_COUNT,
};

enum state state_machine(enum event evt)
{
	static enum state state = YELLOW;

	switch (state) {
	case RED:
		if (evt == GO) {
			state = GREEN;
		}
		break;
	case GREEN:
		if (evt == STOP) {
			state = YELLOW;
		}
		break;
	case YELLOW:
		if (evt == TIMEOUT) {
			state = RED;
		}
		break;
	default:
		k_oops();
	}
	return state;
}

int main(int argc, char *argv[])
{
	enum state current_state = STATE_COUNT;
	enum event evts[] = {GO, STOP, GO, TIMEOUT, STOP, GO, STOP, EVENT_COUNT};
	for (int i = 0; evts[i] != EVENT_COUNT; ++i) {
		current_state = state_machine(evts[i]);
	}
	__ASSERT(current_state == YELLOW, "Must be yellow");
	return 0;
}
```

## src/main_table_driven.c
```c
#include <zephyr/kernel.h>

enum event {
	GO,
	STOP,
	TIMEOUT,
	EVENT_COUNT,
};

enum state {
	RED,
	GREEN,
	YELLOW,
	STATE_COUNT,
};

enum state state_machine[STATE_COUNT][EVENT_COUNT] = {
	[RED] = {[GO] = GREEN, [STOP] = RED, [TIMEOUT] = RED},
	[GREEN] = {[GO] = GREEN, [STOP] = YELLOW, [TIMEOUT] = GREEN},
	[YELLOW] = {[GO] = YELLOW, [STOP] = YELLOW, [TIMEOUT] = RED},
};

int state_action(enum state current_state)
{
	switch (current_state) {
	case RED:
		printk("RED\n");
		return 0;
	case GREEN:
		printk("GREEN\n");
		return 0;
	case YELLOW:
		printk("YELLOW\n");
		return 0;
	case STATE_COUNT:
		return -1;
	}
}

int main(int argc, char *argv[])
{
	enum state current_state = YELLOW;
	enum event evts[] = {GO, STOP, GO, TIMEOUT, STOP, GO, STOP, EVENT_COUNT};
	for (int i = 0; evts[i] != EVENT_COUNT; ++i) {
		enum state new_state = state_machine[current_state][evts[i]];
		if (new_state != current_state) {
			state_action(new_state);
			current_state = new_state;
		}
	}
	__ASSERT(current_state == YELLOW, "Must be yellow");
	return 0;
}
```
